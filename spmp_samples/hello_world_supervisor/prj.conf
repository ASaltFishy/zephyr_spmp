## CMakeLists.txt
```
# SPDX-License-Identifier: Apache-2.0

cmake_minimum_required(VERSION 3.20.0)

set(ZEPHYR_BASE /home/lrc/zephyr-spmp)
set(ZEPHYR_DIR /home/lrc/zephyr-spmp)
set(QEMU_BIN_PATH /home/lrc/zephyr-spmp/qemu/build)
set(ZEPHYR_SDK_INSTALL_DIR /home/lrc/opt/zephyr-sdk/zephyr-sdk-0.16.1)


find_package(Zephyr REQUIRED HINTS ${ZEPHYR_BASE})
project(hello_world_supervisor)

target_sources(app PRIVATE src/main.c)
```

## prj.conf
```kconfig
# nothing here

# for log in kernel
# CONFIG_LOG=y
# CONFIG_ASSERT=y

# # for test and debug
# CONFIG_IRQ_OFFLOAD=y
# CONFIG_THREAD_LOCAL_STORAGE=y
# CONFIG_ZTEST_NEW_API=y

# enable stack protection
# CONFIG_HW_STACK_PROTECTION=y
# CONFIG_SMP=y
# CONFIG_LOG_DEFAULT_LEVEL=0
# CONFIG_LOG_OVERRIDE_LEVEL=0

# for code relocation (貌似并不需要)
# CONFIG_CODE_DATA_RELOCATION=y

# CONFIG_USERSPACE=y
```

## src/main.c
```c
/*
 * Copyright (c) 2012-2014 Wind River Systems, Inc.
 *
 * SPDX-License-Identifier: Apache-2.0
 */

#include <stdio.h>


int main(void)
{
	printf("Hello World! %s\n", CONFIG_BOARD);
	return 0;
}
```
