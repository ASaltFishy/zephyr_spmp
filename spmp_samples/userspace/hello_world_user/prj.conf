## CMakeLists.txt
```
# SPDX-License-Identifier: Apache-2.0
# add_definitions("-Wall -g -O0")

cmake_minimum_required(VERSION 3.20.0)

set(ZEPHYR_BASE /home/lrc/zephyr-spmp)
set(ZEPHYR_DIR /home/lrc/zephyr-spmp)
set(QEMU_BIN_PATH /home/lrc/zephyr-spmp/qemu/build)
set(ZEPHYR_SDK_INSTALL_DIR /home/lrc/zephyr-sdk-0.17.0)
find_package(Zephyr REQUIRED HINTS ${ZEPHYR_BASE})
project(hello_world_user)

target_sources(app PRIVATE src/main.c)
```

## prj.conf
```kconfig
CONFIG_USERSPACE=y
CONFIG_ASSERT=y
CONFIG_APPLICATION_DEFINED_SYSCALL=y

CONFIG_MAIN_STACK_SIZE=2560
CONFIG_HW_STACK_PROTECTION=y
```

## src/main.c
```c
/*
 * Copyright (c) 2020 BayLibre, SAS
 *
 * SPDX-License-Identifier: Apache-2.0
 */

#include <stdio.h>
#include <zephyr/kernel.h>
#include "spmp.h"
#define USER_STACKSIZE 2048

void dump_spmp() {
    printf("\n-----------------DUMP SPMP---------------\n");
    printf("spmpaddr0: 0x%lx\n", SMPU_READ_CFG(0x1b0) << 2);
    printf("spmpaddr1: 0x%lx\n", SMPU_READ_CFG(0x1b1) << 2);
    printf("spmpaddr2: 0x%lx\n", SMPU_READ_CFG(0x1b2) << 2);
    printf("spmpaddr3: 0x%lx\n", SMPU_READ_CFG(0x1b3) << 2);
    printf("spmpaddr4: 0x%lx\n", SMPU_READ_CFG(0x1b4) << 2);
    printf("spmpaddr5: 0x%lx\n", SMPU_READ_CFG(0x1b5) << 2);
    printf("spmpaddr6: 0x%lx\n", SMPU_READ_CFG(0x1b6) << 2);
    printf("spmpaddr7: 0x%lx\n", SMPU_READ_CFG(0x1b7) << 2);
    printf("spmpaddr8: 0x%lx\n", SMPU_READ_CFG(0x1b8) << 2);
    printf("spmpaddr9: 0x%lx\n", SMPU_READ_CFG(0x1b9) << 2);
    printf("spmpaddr10: 0x%lx\n", SMPU_READ_CFG(0x1ba) << 2);
    printf("spmpaddr11: 0x%lx\n", SMPU_READ_CFG(0x1bb) << 2);
    printf("spmpaddr12: 0x%lx\n", SMPU_READ_CFG(0x1bc) << 2);
    printf("spmpaddr13: 0x%lx\n", SMPU_READ_CFG(0x1bd) << 2);
    printf("spmpaddr14: 0x%lx\n", SMPU_READ_CFG(0x1be) << 2);
    printf("spmpaddr15: 0x%lx\n", SMPU_READ_CFG(0x1bf) << 2);

    // print SPMP registers
    printf("spmpcfg0: 0x%lx\n", SMPU_READ_CFG(0x1a0));
    printf("-----------------DUMP SPMP---------------\n\n");

}


struct k_thread user_thread;
K_THREAD_STACK_DEFINE(user_stack, USER_STACKSIZE);

static void user_function(void *p1, void *p2, void *p3) {
    printf("Hello World from %s (%s)\n",
           k_is_user_context() ? "UserSpace!" : "privileged mode.",
           CONFIG_BOARD);
    __ASSERT(k_is_user_context(), "User mode execution was expected");
}

int main(void) {
    dump_spmp();
    k_thread_create(&user_thread, user_stack, USER_STACKSIZE,
                    user_function, NULL, NULL, NULL,
                    -1, K_USER, K_MSEC(0));
    return 0;
}
```

## src/spmp.h
```c
#ifndef SPMP
#define SPMP

#define SMPU_READ_CFG(g) ({                                    \
    unsigned long csr_value;                                      \
    __asm__ volatile("csrr %0, " #g : "=r"(csr_value)); \
    csr_value;                                                    \
})

#define CSR_SMPUCFG0 0x1a0
#define CSR_SMPUCFG1 0x1a1
#define CSR_SMPUCFG2 0x1a2
#define CSR_SMPUCFG3 0x1a3
#define CSR_SMPUCFG4 0x1a4
#define CSR_SMPUCFG5 0x1a5
#define CSR_SMPUCFG6 0x1a6
#define CSR_SMPUCFG7 0x1a7
#define CSR_SMPUCFG8 0x1a8
#define CSR_SMPUCFG9 0x1a9
#define CSR_SMPUCFG10 0x1aa
#define CSR_SMPUCFG11 0x1ab
#define CSR_SMPUCFG12 0x1ac
#define CSR_SMPUCFG13 0x1ad
#define CSR_SMPUCFG14 0x1ae
#define CSR_SMPUCFG15 0x1af
#define CSR_SMPUADDR0 0x1b0
#define CSR_SMPUADDR1 0x1b1
#define CSR_SMPUADDR2 0x1b2
#define CSR_SMPUADDR3 0x1b3
#define CSR_SMPUADDR4 0x1b4
#define CSR_SMPUADDR5 0x1b5
#define CSR_SMPUADDR6 0x1b6
#define CSR_SMPUADDR7 0x1b7
#define CSR_SMPUADDR8 0x1b8
#define CSR_SMPUADDR9 0x1b9
#define CSR_SMPUADDR10 0x1ba
#define CSR_SMPUADDR11 0x1bb
#define CSR_SMPUADDR12 0x1bc
#define CSR_SMPUADDR13 0x1bd
#define CSR_SMPUADDR14 0x1be
#define CSR_SMPUADDR15 0x1bf
#define CSR_SMPUADDR16 0x1c0

#endif
```
