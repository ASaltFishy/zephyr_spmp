## boards/qemu/riscv64/qemu_riscv64_defconfig
```kconfig
# SPDX-License-Identifier: Apache-2.0

CONFIG_PRIVILEGED_STACK_SIZE=2048
CONFIG_CONSOLE=y
CONFIG_SERIAL=y
CONFIG_UART_CONSOLE=y
CONFIG_XIP=n
CONFIG_RISCV_SPMP=y
CONFIG_MP_MAX_NUM_CPUS=4
CONFIG_SMP=y
```
